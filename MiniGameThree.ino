// 'cat_up', 27x25px
const unsigned char cat_up_bitmap[] PROGMEM = {
  0x00, 0x0c, 0x00, 0x00, 0x00, 0x12, 0x00, 0x00, 0x00, 0x12, 0x00, 0x00, 0x00, 0x49, 0x20, 0x00,
  0x00, 0xa9, 0x50, 0x00, 0x01, 0x19, 0x88, 0x00, 0x01, 0x19, 0x88, 0x00, 0x01, 0x09, 0x08, 0x00,
  0x01, 0x09, 0x08, 0x00, 0x01, 0x09, 0x08, 0x00, 0x01, 0x09, 0x08, 0x00, 0x01, 0x09, 0x08, 0x00,
  0x01, 0x09, 0x08, 0x00, 0x01, 0x09, 0x08, 0x00, 0x01, 0x09, 0x08, 0x00, 0x00, 0x89, 0x10, 0x00,
  0x00, 0x69, 0x60, 0x00, 0x00, 0x49, 0x20, 0x00, 0x00, 0x40, 0x20, 0x00, 0x00, 0x40, 0x20, 0x00,
  0x00, 0x40, 0x20, 0x00, 0x00, 0x7f, 0x20, 0x00, 0x00, 0x49, 0x20, 0x00, 0x00, 0x49, 0x20, 0x00,
  0x00, 0x49, 0x20, 0x00
};
// 'cat_down', 27x25px
const unsigned char cat_down_bitmap[] PROGMEM = {
  0x00, 0x03, 0x00, 0x00, 0x00, 0x04, 0x80, 0x00, 0x00, 0x04, 0x80, 0x00, 0x00, 0x49, 0x20, 0x00,
  0x00, 0xa9, 0x50, 0x00, 0x01, 0x19, 0x88, 0x00, 0x01, 0x1f, 0x88, 0x00, 0x01, 0x00, 0x08, 0x00,
  0x01, 0x00, 0x08, 0x00, 0x01, 0x00, 0x08, 0x00, 0x01, 0x20, 0x48, 0x00, 0x01, 0x20, 0x48, 0x00,
  0x01, 0x00, 0x08, 0x00, 0x01, 0x06, 0x08, 0x00, 0x01, 0x00, 0x08, 0x00, 0x00, 0x80, 0x10, 0x00,
  0x00, 0x40, 0x20, 0x00, 0x00, 0x70, 0xe0, 0x00, 0x00, 0x40, 0x20, 0x00, 0x00, 0x40, 0x20, 0x00,
  0x00, 0x40, 0x20, 0x00, 0x00, 0x7f, 0x20, 0x00, 0x00, 0x49, 0x20, 0x00, 0x00, 0x49, 0x20, 0x00,
  0x00, 0x49, 0x20, 0x00
};
// 'cat_left', 27x25px
const unsigned char cat_left_bitmap[] PROGMEM = {
  0x00, 0x00, 0x03, 0x00, 0x00, 0x00, 0x04, 0x80, 0x00, 0x00, 0x04, 0x80, 0x02, 0x00, 0x02, 0x40,
  0x05, 0x00, 0x02, 0x40, 0x08, 0x80, 0x02, 0x40, 0x08, 0x80, 0x02, 0x40, 0x08, 0x60, 0x02, 0x40,
  0x10, 0x10, 0x02, 0x40, 0x20, 0x10, 0x02, 0x40, 0x28, 0x08, 0x02, 0x40, 0x48, 0x08, 0x02, 0x40,
  0x80, 0x08, 0x04, 0x80, 0x80, 0x07, 0xf8, 0x80, 0x40, 0x00, 0x01, 0x00, 0x20, 0x00, 0x02, 0x00,
  0x10, 0x00, 0x02, 0x00, 0x0f, 0x00, 0x01, 0x00, 0x00, 0x88, 0x10, 0x80, 0x01, 0x0f, 0xf8, 0x40,
  0x02, 0x34, 0x46, 0x20, 0x04, 0x62, 0x89, 0x20, 0x08, 0x91, 0x11, 0x20, 0x09, 0x09, 0x21, 0x20,
  0x06, 0x06, 0xc0, 0xc0
};
// 'cat_right', 27x25px
const unsigned char cat_right_bitmap[] PROGMEM = {
  0x18, 0x00, 0x00, 0x00, 0x24, 0x00, 0x00, 0x00, 0x24, 0x00, 0x00, 0x00, 0x48, 0x00, 0x08, 0x00,
  0x48, 0x00, 0x14, 0x00, 0x48, 0x00, 0x22, 0x00, 0x48, 0x00, 0x22, 0x00, 0x48, 0x00, 0xc2, 0x00,
  0x48, 0x01, 0x01, 0x00, 0x48, 0x01, 0x00, 0x80, 0x48, 0x02, 0x02, 0x80, 0x48, 0x02, 0x02, 0x40,
  0x24, 0x02, 0x00, 0x20, 0x23, 0xfc, 0x00, 0x20, 0x10, 0x00, 0x00, 0x40, 0x08, 0x00, 0x00, 0x80,
  0x08, 0x00, 0x01, 0x00, 0x10, 0x00, 0x1e, 0x00, 0x21, 0x02, 0x20, 0x00, 0x43, 0xfe, 0x10, 0x00,
  0x8c, 0x45, 0x88, 0x00, 0x92, 0x28, 0xc4, 0x00, 0x91, 0x11, 0x22, 0x00, 0x90, 0x92, 0x12, 0x00,
  0x60, 0x6c, 0x0c, 0x00
};

const unsigned char* cat_bitmaps[5] = {
  cat_right_bitmap,
  cat_down_bitmap,
  cat_left_bitmap,
  cat_up_bitmap,
  cat_right_bitmap,
};

int mg3_round = 1;
int mg3_health = 3;

int mg3_buttonPressed = false;

int cat_direction = 0;

// red, green, yellow, blue
int mg3_lights[4] = { RED_LED_PIN, GREEN_LED_PIN, YELLOW_LED_PIN, BLUE_LED_PIN };

bool mg3_lights_caught[4] = { false, false, false, false };
bool mg3_lights_on[4] = { false, false, false, false };

int mg3_lights_timer_max[4] = { 1000, 1000, 1000, 1000 };
int mg3_lights_timer[4] = { 0, 0, 0, 0 };

int currentAimedColor = 0;

void miniGameThree() {
  display.clearDisplay();
  drawStatus(mg3_round, mg3_health);

  // Read potentiometer value to determine rotation angle
  int potValue = analogRead(POT_INPUT_PIN);

  if (potValue < 200) {
    cat_direction = 0;
  } else if (potValue < 400) {
    cat_direction = 1;
  } else if (potValue < 600) {
    cat_direction = 2;
  } else if (potValue < 800) {
    cat_direction = 3;
  } else {
    cat_direction = 4;
  }

  if (potValue < 250) {
    currentAimedColor = 0;
  } else if (potValue < 500) {
    currentAimedColor = 3;
  } else if (potValue < 750) {
    currentAimedColor = 2;
  } else if (potValue < 1000) {
    currentAimedColor = 1;
  } else {
    currentAimedColor = 0;
  }

  Serial.print("Current Color Aimed: ");
  Serial.println(currentAimedColor);

  // Draw rotated cat sprite
  display.drawBitmap(centerHor - 27 / 2, centerVer - 25 / 2, cat_bitmaps[cat_direction], 27, 25, WHITE);

  // Map potentiometer value to angle (0 to 360 degrees)
  int angle = map(potValue, 0, 1023, 0, 360);

  // Calculate circle center
  int centerX = SCREEN_WIDTH / 2;
  int centerY = SCREEN_HEIGHT / 2;

  // Draw circle
  int circleRadius = 14;
  // display.drawCircle(centerX, centerY, circleRadius, WHITE);

  // Calculate endpoint of the line sticking out from the circle based on angle
  int lineLength = 30;
  int lineX = centerX + cos(radians(angle)) * circleRadius;
  int lineY = centerY + sin(radians(angle)) * circleRadius;
  int lineEndX = lineX + cos(radians(angle)) * lineLength;
  int lineEndY = lineY + sin(radians(angle)) * lineLength;

  display.drawLine(lineX, lineY, lineEndX, lineEndY, WHITE);

  if (mg3_buttonPressed && mg3_lights_on[currentAimedColor] && !mg3_lights_caught[currentAimedColor]) {
    mg3_lights_caught[currentAimedColor] = true;
    mg3_buttonPressed = false;
    playTone(1000, 200);
    // Serial.println("ENTERED!");
    digitalWrite(mg3_lights[currentAimedColor], 0);
    

    if (mg3_all_lights_caught() == 4) {
      vibrate(1000);
      mg3_round++;

      if (mg3_round <= 3) {
        mg3_manage_lights();
        mg3_reset_lights_caught();
        mg3_randomize_lights();
      }
    }
  } else if (mg3_buttonPressed && !mg3_lights_on[currentAimedColor]) {
    mg3_buttonPressed = false;
    mg3_health--;
  } else if (!mg3_buttonPressed && !mg3_lights_caught[currentAimedColor] && mg3_lights_on[currentAimedColor]) {
    playTone(200, 10);
  }

  if (digitalRead(BUTTON_PIN) == LOW) {
    mg3_buttonPressed = true;
  }

  mg3_add_time();
  mg3_manage_lights();

  display.setCursor(16, 52);
  display.setTextColor(WHITE);
  display.setTextSize(1);
  display.print("Lights Caught:");
  display.println(mg3_all_lights_caught());

  display.display();

  delay(10);  // Adjust the delay as needed
}

void mg3_reset() {
  mg3_round = 1;
  mg3_health = 3;
  mg3_buttonPressed = false;
  cat_direction = 0;

  mg3_reset_lights_caught();
  mg3_reset_light_timers();
}

void mg3_manage_lights() {
  for (int i = 0; i < 4; ++i) {
    if (!mg3_lights_caught[i] && mg3_lights_on[i]) {
      digitalWrite(mg3_lights[i], 1);
    } else {
      digitalWrite(mg3_lights[i], 0);
    }
  }
}

void mg3_reset_lights_caught() {
  for (int i = 0; i < 4; ++i) {
    mg3_lights_caught[i] = false;
    mg3_lights_on[i] = false;
  }
}

void mg3_reset_light_timers() {
  for (int i = 0; i < 4; ++i) {
    mg3_lights_timer_max[i] = 1000;
    mg3_lights_timer[i] = 0;
  }
}

void mg3_randomize_lights() {
  for (int i = 0; i < 4; ++i) {
    mg3_lights_timer[i] = random(0, 200);
    mg3_lights_timer_max[i] = random(200, 1000 - ((mg3_round - 1) * 200));
  }
}

void mg3_add_time() {
  for (int i = 0; i < 4; ++i) {
    mg3_lights_timer[i] += 10;
    if (mg3_lights_timer[i] > mg3_lights_timer_max[i]) {
      mg3_lights_on[i] = !mg3_lights_on[i];
      mg3_lights_timer[i] = random(0, 200);
    }
  }
}

int mg3_all_lights_caught() {
  int count = 0;
  for (int i = 0; i < 4; i++) {
    if (mg3_lights_caught[i]) {
      count++;
    }
  }

  return count;
}